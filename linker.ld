OUTPUT_FORMAT(elf32-i386)                       /* 指定链接器生成 32 位 x86 ELF 文件。 */
ENTRY(kernel_main)                              /* 指定内核的入口符号是 kernel_main。 */

SECTIONS                                        /* 开始定义各段在内存中的布局。 */
{                                               /* 开始链接脚本主体。 */
    . = 0x10000;                                /* 令第一个输出字节的运行地址为 0x10000，与加载地址一致。 */
    .text : { *(.text*) }                       /* 放置编译器生成的机器指令。 */
    .rodata : { *(.rodata*) }                   /* 放置只读数据，例如 C 字符串。 */
    .data : { *(.data*) }                       /* 放置已初始化的可写全局数据。 */
    .bss : { *(COMMON) *(.bss*) }               /* 放置未初始化数据；当前最小内核尚未使用它。 */
}                                               /* 结束链接脚本主体。 */
